## qcom/opensource/wlan/qcacld-3.0/Kconfig
```kconfig
comment "Qualcomm Atheros CLD WLAN module"

config QCA_CLD_WLAN
	tristate "Qualcomm Atheros CLD WLAN module"
	default n
	help
	  Add support for the Qualcomm Atheros CLD WLAN module

if QCA_CLD_WLAN != n

config QCA_CLD_WLAN_PROFILE
	string "Configuration profile for Qualcomm Atheros CLD WLAN module"
	default "default"
	help
	  Specify which configuration profile to be used for building
	  this module.

config WLAN_FEATURE_SARV1_TO_SARV2
	bool "Enable conversion of SAR v1 to v2 feature"
	default n
	  Profiles are located at sm6225-modules/qcom/opensource/wlan/qcacld-3.0/configs.

endif # QCA_CLD_WLAN
```
